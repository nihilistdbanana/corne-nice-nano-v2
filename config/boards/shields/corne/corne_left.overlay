/*
 * Copyright (c) 2020 Pete Johanson
 *
 * SPDX-License-Identifier: MIT
 <15 0 &gpio1 13 0>  /* D15 */        ->   <7 0 &gpio1 0 0>  /* D6/A7 */
 <19 0 &gpio0 2 0>   /* D19/A1 */     ->   <8 0 &gpio1 4 0>      /* D8/A8 */
 <20 0 &gpio0 29 0>  /* D20/A2 */     ->   <3 0 &gpio0 20 0>     /* D3 */
 */

#include "corne.dtsi"

&kscan0 {
    col-gpios
        = <&pro_micro 21 GPIO_ACTIVE_HIGH>
        , <&pro_micro 3 GPIO_ACTIVE_HIGH>
        , <&pro_micro 8 GPIO_ACTIVE_HIGH>
        , <&pro_micro 18 GPIO_ACTIVE_HIGH>
        , <&pro_micro 7 GPIO_ACTIVE_HIGH>
        , <&pro_micro 14 GPIO_ACTIVE_HIGH>
        ;
};
